## drivers/gpio0/Kconfig
```kconfig
#
# Allwinner sunxi-gpio0 driver.
#
config SUNXI_GPIO0
    tristate "SUNXI axp gpio0 irq enable"
    default n
    help
      This enables support for the axp gpio0 irq 
```

## drivers/gpio2/Kconfig
```kconfig
#
# Allwinner sunxi-gpio2 driver.
#
config SUNXI_GPIO2
    tristate "SUNXI axp gpio2 irq enable"
    default n
    help
      This enables support for the axp gpio2 irq 
```

## drivers/input/touchscreen/cyttsp4/Kconfig
```kconfig
	  
config TOUCHSCREEN_CYPRESS_CYTTSP4
	tristate "Cypress TrueTouch Gen4 Touchscreen Driver"
	help
	  Core driver for Cypress TrueTouch(tm) Standard Product
	  Generation4 touchscreen controllers.

	  Say Y here if you have a Cypress Gen4 touchscreen.

	  If unsure, say N.

	  To compile this driver as a module, choose M here: the
	  module will be called cyttsp4.
	  
choice
	bool "Cypress TrueTouch Gen4 MultiTouch Protocol"
	depends on TOUCHSCREEN_CYPRESS_CYTTSP4
	default TOUCHSCREEN_CYPRESS_CYTTSP4_MT_B
	help
	  This option controls which MultiTouch protocol will be used to
	  report the touch events.
	  
config TOUCHSCREEN_CYPRESS_CYTTSP4_MT_A
	bool "Protocol A"
	help
	  Select to enable MultiTouch touch reporting using protocol A
	  on Cypress TrueTouch(tm) Standard Product Generation4 touchscreen
	  controller.

config TOUCHSCREEN_CYPRESS_CYTTSP4_MT_B
	bool "Protocol B"
	help
	  Select to enable MultiTouch touch reporting using protocol B
	  on Cypress TrueTouch(tm) Standard Product Generation4 touchscreen
	  controller.

endchoice 






config TOUCHSCREEN_CYPRESS_CYTTSP4_BUTTON
	bool "Cypress TrueTouch Gen4 MultiTouch CapSense Button"
	depends on TOUCHSCREEN_CYPRESS_CYTTSP4
	help
	  Say Y here to enable CapSense reporting on Cypress TrueTouch(tm)
	  Standard Product Generation4 touchscreen controller.

	  If unsure, say N.

config TOUCHSCREEN_CYPRESS_CYTTSP4_PROXIMITY
	bool "Cypress TrueTouch Gen4 Proximity"
	depends on TOUCHSCREEN_CYPRESS_CYTTSP4
	help
	  Say Y here to enable proximity reporting on Cypress TrueTouch(tm)
	  Standard Product Generation4 touchscreen controller.

	  If unsure, say N.
```

## drivers/input/touchscreen/ektf2k/Kconfig
```kconfig
#
#  Touchscreen driver configuration
#
config  TOUCHSCREEN_EKTF2K
       tristate  "ektf2k touchscreen driver"      
       depends on INPUT && I2C
       default m
       help
         ektf2k    
         
```

## drivers/video/sw-epd/Kconfig
```kconfig
#
# Video configuration for sunxi platform
#

menu "Video support for sunxi"
	depends on FB

config FB_CONSOLE_SUNXI
  bool "Framebuffer Console Support(sunxi)"
  select FB_CFB_FILLRECT
  select FB_CFB_COPYAREA
  select FB_CFB_IMAGEBLIT
  default n
  ---help---

config SWEPD
  tristate "Software EPDC driver support for B288"
  depends on (ARCH_SUNXI)
  default n
  ---help---

endmenu
```
